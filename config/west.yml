## config/west.yml
```yaml
manifest:
  remotes:
    - name: zmkfirmware
      url: https://github.com
    - name: victorlucachi
      url: https://github.com/victorlucachi
  projects:
    - name: zmk
      remote: zmkfirmware
      revision: main
      import: app/west.yml
    - name: charybdis-zmk-module
      remote: victorlucachi
      revision: main
```
